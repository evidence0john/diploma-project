#include "common_definitions.h"
#include <avr/io.h>
#include <avr/pgmspace.h>
#include "nokia_5110_lcd.h"

const char pic[] PROGMEM =

{
	0X00, 0X00, 0X00, 0X00, 0X00, 0X00, 0X00, 0XE0, 0X10, 0X08, 0X08, 0X18, 0X00, 0X00, 0X00, 0X00,
	0XE0, 0X18, 0XE0, 0X00, 0X00, 0X08, 0XF8, 0X78, 0X80, 0X78, 0XF8, 0X08, 0X08, 0XF8, 0X88, 0X88,
	0XC8, 0X18, 0X00, 0X00, 0X00, 0X00, 0X00, 0X00, 0X00, 0X00, 0XE0, 0X10, 0X08, 0X08, 0X10, 0XE0,
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	0X03, 0X01, 0X01, 0X01, 0X05, 0X05, 0X05, 0X05,
};





void refresh_screen()
{
	unsigned char x;
	unsigned char y;
	for(y = 0; y < 6; y++)
	{
		for(x = 0; x < 84; x++)
		{
			Writebyte(1,pgm_read_byte(pic + (y * 84 + x)));
		}
	}
}

const char eh[] PROGMEM =
{
0x10,0x10,0xD0,0xFF,0x90,0x10,0x00,0xFE,0x12,0x92,0x92,0xF2,0x92,0x92,0x12,0x00,
0x04,0x03,0x00,0xFF,0x00,0x03,0x00,0x7F,0x48,0x48,0x48,0x4F,0x48,0x48,0x48,0x00,
};

void refresh()
{
	SetX_Y(12, 3);
	for(int x = 0; x < 16; x++)
	{
		Writebyte(1,pgm_read_byte(eh + x));
	}
	SetX_Y(12, 4);
	for(int x = 16; x < 32; x++)
	{
		Writebyte(1,pgm_read_byte(eh + x));
	}
}
const char english[][6] PROGMEM =
{
	{ 0x00, 0x00, 0x00, 0x00, 0x00, 0x00 },   // sp
	{ 0x00, 0x00, 0x00, 0x2f, 0x00, 0x00 },   // !
	{ 0x00, 0x00, 0x07, 0x00, 0x07, 0x00 },   // "
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	{ 0x14, 0x14, 0x14, 0x14, 0x14, 0x14 }    // horiz lines
};


void IOinit()
{
	DDRX |= 0xFF;
	//DDRB|=_BV(DDB2);
}

void Writebyte(unsigned char d_cflag, unsigned char din)
{
	unsigned char tmp;
	int i;
	tmp = din;
	PORTD &= ~_BV(SCE);
	if(d_cflag == 0) PORTD &= ~_BV(D_C);
	else PORTD |= _BV(D_C);
	for(i = 8; i > 0; i--)
	{
		PORTD &= ~_BV(SCK);
		if(tmp & 0x80) PORTD |= _BV(SDIN);
		else PORTD &= ~_BV(SDIN);
		PORTD |= _BV(SCK);
		tmp = tmp << 1;
	}
	PORTD |= _BV(SCE);
}

void Lcdclear()
{
	unsigned int i;
	Writebyte(0, 0x0c);
	Writebyte(0, 0x80);
	for(i = 0; i < 504; i++)
	Writebyte(1, 0);
}

void Lcdinit()
{
	PORTD &= ~_BV(RST);
	//_delay_us(1);
	PORTD |= _BV(RST);
	Writebyte(0, 0x21);
	Writebyte(0, 0xc0);
	Writebyte(0, 0x07);
	Writebyte(0, 0x13);
	Writebyte(0, 0x20);
	Lcdclear();
	Writebyte(0, 0x0c);
}

void SetX_Y(unsigned char x, unsigned char y)
{
	Writebyte(0, 0x80 | x);
	Writebyte(0, 0x40 | y);
}

void Writeletter(unsigned char letter)
{
	unsigned char i;
	unsigned char letter_disp[6];
	if(letter)
	{
		letter = letter - 32;
		for(i = 0; i < 6; i++)
		{
			letter_disp[i] = pgm_read_byte(english[letter] + i);
		}
		for(i = 0; i < 6; i++)
		Writebyte(1, letter_disp[i]);
	}
}

void Writedata_hex(unsigned char outdata)
{
	unsigned char outtmp;
	outtmp = outdata;
	if((outtmp >> 4) <= 0x09)
	Writeletter((outtmp >> 4) + 48);
	else
	Writeletter((outtmp >> 4) + 55);
	if((outtmp & 0x0f) <= 0x09)
	Writeletter((outtmp & 0x0f) + 48);
	else
	Writeletter((outtmp & 0x0f) + 55);
}

void Writedata_dec(unsigned char outdata)
{
	unsigned char getmp, shitmp, baitmp;

	if(outdata >= 0x64)
	{
		baitmp = outdata / 100;
		Writeletter(baitmp + 48);
	}
	shitmp = (outdata / 10) % 10;
	getmp = outdata % 10;
	Writeletter(shitmp + 48);
	Writeletter(getmp + 48);
}

void Writestring(unsigned char x_add, unsigned char y_add, char *str)
{
	SetX_Y(x_add, y_add);
	if (!*str)
		str++;
	while (*str)
	{
		Writeletter(*str);
		str++;
	}
}