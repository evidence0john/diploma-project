/*
 * hardspi.c
 *
 * Created: 2017/5/9 9:23:00
 *  Author: evide
 */ 


#include <avr/io.h>
#define F_CPU 8000000UL
#include "util/delay.h"
#include <avr/pgmspace.h>
#include "avr/interrupt.h"

#define Set_Bit(val, bitn)    (val |=(1<<(bitn)))
#define Clr_Bit(val, bitn)     (val&=~(1<<(bitn)))
#define Get_Bit(val, bitn)    (val &(1<<(bitn)) )




void Lcd_send_byte(char cData)
{
	SPDR = cData;
	while(!(SPSR & (1<<SPIF)));
}

void Lcd_Writebyte(unsigned char d_cflag,unsigned char din)
{
	if(d_cflag==0) Clr_Bit(PORTB, 0);
	else  Set_Bit(PORTB, 0);
	Lcd_send_byte(din);
}

void Lcd_SetX_Y(unsigned char x,unsigned char y)
{
	Lcd_Writebyte(0,0x80|x);
	Lcd_Writebyte(0,0x40|y);
}

void Lcd_clear()
{
	unsigned int i;
	Lcd_Writebyte(0,0x0c);
	Lcd_Writebyte(0,0x80);
	for(i=0;i<504;i++)
		Lcd_Writebyte(1,0);
}

void Lcd_init()
{
	DDRB = 0xff;
	SPCR = (1<<SPE)|(1<<MSTR);//|(1<<SPR0)|(1<<SPR1);
	Clr_Bit(PORTB, 1);
	_delay_us(10);
	Set_Bit(PORTB, 1);
	Lcd_Writebyte(0,0x21);
	Lcd_Writebyte(0,0xc0);
	Lcd_Writebyte(0,0x06);
	Lcd_Writebyte(0,0x13);
	Lcd_Writebyte(0,0x20);
	Lcd_clear();
	Lcd_Writebyte(0,0x0c);
}


const char english[][6] PROGMEM =
{
{ 0x00, 0x00, 0x00, 0x00, 0x00, 0x00 },   // sp
{ 0x00, 0x00, 0x00, 0x2f, 0x00, 0x00 },   // !
{ 0x00, 0x00, 0x07, 0x00, 0x07, 0x00 },   // "
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{ 0x14, 0x14, 0x14, 0x14, 0x14, 0x14 }    // horiz lines
};
void Lcd_Writeletter(unsigned char letter)
{
	unsigned char i;
	unsigned char letter_disp[6];
	letter = letter - 32;
	for(i = 0; i < 6; i++)
	{
		letter_disp[i] = pgm_read_byte(english[letter] + i);
	}
	for(i = 0; i < 6; i++)
	Lcd_Writebyte(1, letter_disp[i]);
}


void Lcd_Writestring(unsigned char x_add, unsigned char y_add, char *str)
{
	Lcd_SetX_Y(x_add, y_add);
	while (*str)
	{
		Lcd_Writeletter(*str);
		str++;
	}
}

void Lcd_NOP()
{
	Lcd_Writebyte(0, 0);
}

#include "stdio.h"
#include "string.h"

void PCINT_init()
{
	PCICR |= _BV(PCIE1);
	PCMSK1 |= _BV(PCINT8);
}

char lcstr[16];
char cstr[16];
unsigned int counter = 0;
unsigned long lcounter = 0;
unsigned int tcounter = 0;

int main(void)
{
	Lcd_init();
	DDRC = 0;
	PCINT_init();
	sei();
	while(1){
		tcounter ++;
		_delay_ms(1000);
		Lcd_clear();
		counter = counter >> 1;
		Lcd_Writestring(0, 0, "Current Speed");
		sprintf(cstr, "%d rps", counter);
		Lcd_Writestring(10, 2, cstr);
		counter *= 60;
		sprintf(cstr, "%d rpm", counter);
		Lcd_Writestring(10, 3, cstr);
		counter = 0;
		if (tcounter == 60)
		{
			lcounter = lcounter >> 1;
			sprintf(lcstr, "%d rpm", lcounter);
			tcounter = 0;
			lcounter = 0;
		}
		Lcd_Writestring(10, 4, "Last 1 min");
		Lcd_Writestring(10, 5, lcstr);
		Lcd_NOP();
	}		
}

ISR(PCINT1_vect)
{
	counter ++;
	lcounter ++;
}